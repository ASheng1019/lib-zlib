## tests/contract/defconfig
```kconfig
CONFIG_ARCH_ARM_64=y
CONFIG_PLAT_KVM=y
CONFIG_KVM_VMM_QEMU=y
CONFIG_KVM_BOOT_PROTO_QEMU_VIRT=y
# CONFIG_LIBUKINTCTLR_GICV2 is not set
CONFIG_LIBUKINTCTLR_GICV3=y
CONFIG_LIBUKRANDOM=y
CONFIG_LIBUKRANDOM_DTB_SEED=y
# CONFIG_LIBUKRANDOM_LCPU is not set
CONFIG_LIBUKPRINT_KLVL_INFO=y
CONFIG_LIBUKBOOT_BANNER_MINIMAL=y
CONFIG_LIBMUSL=y
CONFIG_LIBPOSIX_TIME=y
CONFIG_LIBPOSIX_POLL=y
CONFIG_LIBPOSIX_TTY=y
CONFIG_LIBPOSIX_TTY_STDIO=y
CONFIG_LIBPOSIX_TTY_STDOUT_SERIAL=y

CONFIG_LIBPOSIX_VFS_FSTAB=y
CONFIG_LIBPOSIX_VFS_FSTAB_BUILTIN=y
CONFIG_LIBPOSIX_VFS_FSTAB_BUILTIN_RAMFS=y

# CONFIG_ARM64_ERRATUM_843419 is not set

CONFIG_LIBZLIB=y
```
